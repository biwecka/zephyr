## CMakeLists.txt
```
cmake_minimum_required(VERSION 3.13.1)

# Re-direct the directory where the 'boards' directory is found from
# $ZEPHYR_BASE to this directory.
set(BOARD arduino_nano_33_ble_sense)

# This sample is only compatible with arduino_nano_33_ble_sense because
# it has re-directed the 'boards' directory to a directory that only
# contains this board.
# set(BOARD arduino_nano_33_ble_sense)

# Find Zephyr. This also loads Zephyr's build system.
find_package(Zephyr REQUIRED HINTS $ENV{ZEPHYR_BASE}) #find_package(Zephyr)
project(sensor_test)

# Add your source file to the "app" target. This must come after
# find_package(Zephyr) which defines the target.
FILE(GLOB_RECURSE app_sources src/*.c)
target_sources(app PRIVATE ${app_sources}) #target_sources(app PRIVATE src/main.c)
```

## prj.conf
```kconfig
################################################################################
### General drivers

# Enable SPI driver. Cannot be used together with led_builtin.
#CONFIG_SPI=y

# Enable UART driver
CONFIG_SERIAL=y

# Enable I2C driver
CONFIG_I2C=y

################################################################################
### Sensor drivers

# Enable "sensor" => Required for using the sensor drivers
CONFIG_SENSOR=y

# Enable APDS 9960 driver (proximity, light, color, gesture)
CONFIG_APDS9960=y

# Enable HTS221 driver (temperature, humidity)
CONFIG_HTS221=y
CONFIG_HTS221_TRIGGER_NONE=y

# Enable LPS22HB driver (pressure, temperature)
CONFIG_LPS22HB=y

################################################################################
# Enable USB (NRFX driver + device stack)
CONFIG_USB=y

# Enable USB console output (input not yet supported)
CONFIG_CONSOLE=y
CONFIG_USB_UART_CONSOLE=y
#CONFIG_USB_UART_DTR_WAIT=y
CONFIG_UART_LINE_CTRL=y
CONFIG_UART_INTERRUPT_DRIVEN=y
CONFIG_UART_CONSOLE_ON_DEV_NAME="CDC_ACM_0"

# Enable printk(...) output via console
CONFIG_PRINTK=y
CONFIG_UART_CONSOLE_INIT_PRIORITY=91

CONFIG_LOG=y
CONFIG_LOG_PRINTK=y
################################################################################
```

## src/main.c
```c
/*
* Copyright (c) 2016 Intel Corporation
*
* SPDX-License-Identifier: Apache-2.0
*/

#include <zephyr.h>
#include <device.h>
#include <devicetree.h>
#include <drivers/gpio.h>
#include <drivers/sensor.h>
#include <sys/printk.h>
#include <stdio.h>

#include "usb/usb.h"

/* 1000 msec = 1 sec */
#define SLEEP_TIME_MS   1000

////////////////////////////////////////////////////////////////////////////////
////////////////////////////////////////////////////////////////////////////////
////////////////////////////////////////////////////////////////////////////////
static void process_sample(const struct device *dev)
{
	static unsigned int obs;
	struct sensor_value pressure, temp;

	if (sensor_sample_fetch(dev) < 0) {
		printf("Sensor sample update error\n");
		return;
	}

	if (sensor_channel_get(dev, SENSOR_CHAN_PRESS, &pressure) < 0) {
		printf("Cannot read LPS22HB pressure channel\n");
		return;
	}

	if (sensor_channel_get(dev, SENSOR_CHAN_AMBIENT_TEMP, &temp) < 0) {
		printf("Cannot read LPS22HB temperature channel\n");
		return;
	}

	++obs;
	printf("Observation:%u\n", obs);

	/* display pressure */
	printf("Pressure:%.1f kPa\n", sensor_value_to_double(&pressure));

	/* display temperature */
	printf("Temperature:%.1f C\n", sensor_value_to_double(&temp));

}
////////////////////////////////////////////////////////////////////////////////
////////////////////////////////////////////////////////////////////////////////
////////////////////////////////////////////////////////////////////////////////

void main(void)
{
    init_usb(true);

    int ret = 0;

    ////////////////////////////////////////////////////////////////////////////
    // Turn on led_pwr
    const struct device *led_pwr_dev = device_get_binding(
        DT_GPIO_LABEL(DT_NODELABEL(led_pwr), gpios)
    );
    if (led_pwr_dev == NULL) {
        return;
    }
    ret = gpio_pin_configure(
        led_pwr_dev,
        DT_GPIO_PIN(DT_NODELABEL(led_pwr), gpios), GPIO_OUTPUT_HIGH
    );
    if (ret < 0) {
        return;
    }

    ////////////////////////////////////////////////////////////////////////////
    // Turn off led_builtin
    const struct device *led_builtin_dev = device_get_binding(
        DT_GPIO_LABEL(DT_NODELABEL(led_builtin), gpios)
    );
    if (led_builtin_dev == NULL) {
        return;
    }
    ret = gpio_pin_configure(
        led_builtin_dev,
        DT_GPIO_PIN(DT_NODELABEL(led_builtin), gpios), GPIO_OUTPUT_LOW
    );
    if (ret < 0) {
        return;
    }

    ////////////////////////////////////////////////////////////////////////////
    // Get ... device
    const struct device *dev = device_get_binding(DT_LABEL(DT_INST(0, st_lps22hb_press)));

	if (dev == NULL) {
		printf("Could not get LPS22HB device\n");
		return;
	}
    ////////////////////////////////////////////////////////////////////////////
    bool led_is_on = true;

    while (1) {
        gpio_pin_set(
            led_builtin_dev,
            DT_GPIO_PIN(DT_NODELABEL(led_builtin), gpios),
            (int)led_is_on
        );

        led_is_on = !led_is_on;
        k_msleep(SLEEP_TIME_MS);

        // Sensor values - START
        process_sample(dev);
        // Sensor values - END
    }
    ////////////////////////////////////////////////////////////////////////////
}
```
