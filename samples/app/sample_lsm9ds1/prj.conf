## CMakeLists.txt
```
cmake_minimum_required(VERSION 3.13.1)

# Re-direct the directory where the 'boards' directory is found from
# $ZEPHYR_BASE to this directory.
#set(BOARD_ROOT ${CMAKE_CURRENT_LIST_DIR})
set(BOARD arduino_nano_33_ble_sense)

# Add out of tree drivers
# list(APPEND ZEPHYR_EXTRA_MODULES
#   ${CMAKE_CURRENT_SOURCE_DIR}/drivers/sensor/lsm9ds1
# )

# This sample is only compatible with arduino_nano_33_ble_sense because
# it has re-directed the 'boards' directory to a directory that only
# contains this board.
# set(BOARD arduino_nano_33_ble_sense)

# Find Zephyr. This also loads Zephyr's build system.
find_package(Zephyr REQUIRED HINTS $ENV{ZEPHYR_BASE}) #find_package(Zephyr)
project(sensor_test)

# Add your source file to the "app" target. This must come after
# find_package(Zephyr) which defines the target.
FILE(GLOB_RECURSE app_sources src/*.c)
target_sources(app PRIVATE ${app_sources}) #target_sources(app PRIVATE src/main.c)
```

## prj.conf
```kconfig
################################################################################
### ...

# For using <math.h>
CONFIG_NEWLIB_LIBC=y

# For using printf with floats
CONFIG_NEWLIB_LIBC_FLOAT_PRINTF=y

################################################################################
### General drivers

# Enable SPI driver. Cannot be used together with led_builtin.
#CONFIG_SPI=y

# Enable UART driver
CONFIG_SERIAL=y

# Enable I2C driver
CONFIG_I2C=y

################################################################################
### Sensor drivers

# Enable "sensor" => Required for using the sensor drivers
CONFIG_SENSOR=y

# Enable APDS 9960 driver (proximity, light, color, gesture)
#CONFIG_APDS9960=y

# Enable HTS221 driver (temperature, humidity)
#CONFIG_HTS221=y
#CONFIG_HTS221_TRIGGER_NONE=y

# Enable LPS22HB driver (pressure, temperature)
#CONFIG_LPS22HB=y

# Enable LSM9DS1 driver (acceleration, gyroskop, magnetic)
CONFIG_LSM9DS1=y
CONFIG_LSM9DS1_GYRO_LOW_POWER=y

CONFIG_I2C_NRFX=y
# CONFIG_I2C_1_NRF_TWIM=y
#CONFIG_I2C_INIT_PRIORITY=60
#CONFIG_I2C_0=n
#CONFIG_LSM9DS1_I2C_MASTER_DEV_NAME="I2C_1"

################################################################################
# Enable USB (NRFX driver + device stack)
CONFIG_USB=y

# Enable USB console output (input not yet supported)
CONFIG_CONSOLE=y
CONFIG_USB_UART_CONSOLE=y
#CONFIG_USB_UART_DTR_WAIT=y
CONFIG_UART_LINE_CTRL=y
CONFIG_UART_INTERRUPT_DRIVEN=y
CONFIG_UART_CONSOLE_ON_DEV_NAME="CDC_ACM_0"

# Enable printk(...) output via console
CONFIG_PRINTK=y
CONFIG_UART_CONSOLE_INIT_PRIORITY=91

CONFIG_LOG=y
CONFIG_LOG_PRINTK=y
################################################################################
```

## src/main.c
```c
/*
* Copyright (c) 2016 Intel Corporation
*
* SPDX-License-Identifier: Apache-2.0
*/

#include <zephyr.h>
#include <device.h>
#include <devicetree.h>
#include <drivers/gpio.h>
#include <drivers/sensor.h>
#include <sys/printk.h>
#include <stdio.h>
#include <string.h>

#include <drivers/sensor/lsm9ds1.h>

//#include "MadgwickAHRS.h"

#include "usb/usb.h"

////////////////////////////////////////////////////////////////////////////////

void main(void)
{
    init_usb(false);

    int ret = 0;

    ////////////////////////////////////////////////////////////////////////////
    // Turn on led_pwr
    const struct device *led_pwr_dev = device_get_binding(
        DT_GPIO_LABEL(DT_NODELABEL(led_pwr), gpios)
    );
    if (led_pwr_dev == NULL) {
        return;
    }
    ret = gpio_pin_configure(
        led_pwr_dev,
        DT_GPIO_PIN(DT_NODELABEL(led_pwr), gpios), GPIO_OUTPUT_HIGH
    );
    if (ret < 0) {
        return;
    }

    ////////////////////////////////////////////////////////////////////////////
    // Get LSM9DS1 and calibrate it
    const struct device *lsm9ds1_dev = device_get_binding(
        DT_LABEL(DT_INST(0, st_lsm9ds1))
    );

    if (lsm9ds1_dev == NULL) {
        printk("lsm9ds1_dev == NULL; => Programm abgebrochen.\n");
    }

    // Trigger sensor calibration
    sensor_attr_set(
        lsm9ds1_dev,
        SENSOR_CHAN_ACCEL_XYZ,
        SENSOR_ATTR_CALIB_TARGET,
        NULL
    );

    k_msleep(100);

    ////////////////////////////////////////////////////////////////////////////
    //Turn on orange LED
    const struct device *led_builtin_dev = device_get_binding(
        DT_GPIO_LABEL(DT_NODELABEL(led_builtin), gpios)
    );
    if (led_builtin_dev == NULL) {
        return;
    }
    ret = gpio_pin_configure(
        led_builtin_dev,
        DT_GPIO_PIN(DT_NODELABEL(led_builtin), gpios), GPIO_OUTPUT_HIGH //GPIO_OUTPUT_LOW
    );
    if (ret < 0) {
        return;
    }

    ////////////////////////////////////////////////////////////////////////////
    while (1) {
        // Fetch values from sensor into the driver
        if (sensor_sample_fetch_chan(lsm9ds1_dev, SENSOR_CHAN_ACCEL_XYZ) < 0) {
            printf("Sensor sample update error\n");
            return;
        }

        // Read the fetched values from the driver
        struct sensor_value data[3];
        sensor_channel_get(lsm9ds1_dev, SENSOR_CHAN_ACCEL_XYZ, data);

        // Print out the values
        printf("%f\t\t%f\t\t%f\n",
            sensor_value_to_double(data),
            sensor_value_to_double(data+1),
            sensor_value_to_double(data+2)
        );

        // Wait before getting new values
        k_msleep(50);
    }
    ////////////////////////////////////////////////////////////////////////////
}
```
