## prj.conf
```kconfig
################################################################################
# GENERAL #
###########

# This option directs printk() debugging output to the supported console device,
# rather than suppressing the generation of printk() output entirely.
# Output is sent immediately, without any mutual exclusion or buffering.
CONFIG_PRINTK=y

# For using <math.h>
CONFIG_NEWLIB_LIBC=y

# For using printf with floats
CONFIG_NEWLIB_LIBC_FLOAT_PRINTF=y

# Global switch for the logger,
# when turned off log calls will not be compiled in.
CONFIG_LOG=y

################################################################################
# DRIVERS #
###########

# Include GPIO drivers in system config
CONFIG_GPIO=y

# Enable USB drivers
CONFIG_USB=y

# Enable options for serial drivers.
CONFIG_SERIAL=y

# Enable console
CONFIG_CONSOLE=y

CONFIG_SENSOR_POWER_PINS_INIT_PRIORITY=59

##############################################################
# Enable I2C driver (for sensors)
CONFIG_I2C=y

# Enable "sensor" => Required for using the sensor drivers
CONFIG_SENSOR=y

###########
# LSM9DS1 #
###########
# Enable APDS 9960 driver (proximity, light, color, gesture)
CONFIG_APDS9960=y

# Enable HTS221 driver (temperature, humidity)
CONFIG_HTS221=y
CONFIG_HTS221_TRIGGER_NONE=y

# Enable LPS22HB driver (pressure, temperature)
CONFIG_LPS22HB=y

# Enable LSM9DS1 driver (acceleration, gyroskop, magnetic)
CONFIG_LSM9DS1=y
#CONFIG_LSM9DS1_GYRO_LOW_POWER=y

################################################################################
# USB #
#######

# Enable USB device stack
CONFIG_USB_DEVICE_STACK=y
# USB device product string.
CONFIG_USB_DEVICE_PRODUCT="Zephyr USB console sample"

# Enable this option to use the USB UART for console output. The output can
# be viewed from the USB host via /dev/ttyACM* port. Note that console inputs
# from the USB UART are not functional yet. Also since the USB layer currently
# doesn't support multiple interfaces, this shouldn't be selected in
# conjunction with, say, USB Mass Storage.
CONFIG_USB_UART_CONSOLE=y

################################################################################
# UART #
########

# USB CDC ACM device class driver. Default device name is “CDC_ACM_0”.
CONFIG_USB_CDC_ACM=y

# This option specifies the name of UART device to be used for the
# SHELL UART backend. In case when DTS is enabled (HAS_DTS),
# the default value is set from DTS chosen node ‘zephyr,shell-uart’
# but can be overridden here.
CONFIG_UART_SHELL_ON_DEV_NAME="CDC_ACM_0"

# This option specifies the name of UART device to be used for UART console.
CONFIG_UART_CONSOLE_ON_DEV_NAME="CDC_ACM_0"

# This option enables interrupt support for UART
# allowing console input and other UART based drivers.
CONFIG_UART_INTERRUPT_DRIVEN=y

# This enables the API for apps to control the serial line,
# such as baud rate, CTS and RTS.
# Implementation is up to individual driver. Says no if not sure.
CONFIG_UART_LINE_CTRL=y

################################################################################
# SHELL #
#########
# The settings below are partly from
# zephyr/samples/subsys/shell/shell_module/prj_minimal.conf

# Shell configurations
CONFIG_SHELL=y
CONFIG_SHELL_BACKEND_SERIAL=y
CONFIG_SHELL_STACK_SIZE=1024
CONFIG_SHELL_CMD_BUFF_SIZE=128

# Enable built-in commands like ‘clear’, ‘history’, etc.
CONFIG_SHELL_CMDS=y

# Enable commands history. History can be accessed using up and down arrows.
CONFIG_SHELL_HISTORY=y

# Enable printing help on wrong argument count.
CONFIG_SHELL_HELP_ON_WRONG_ARGUMENT_COUNT=y

# Enables using wildcards: * and ? in the shell.
CONFIG_SHELL_WILDCARD=n

# This shell provides access to basic kernel data like
# version, uptime and other useful information.
### CONFIG_KERNEL_SHELL=y

# Enable shell statistics.
### CONFIG_SHELL_STATS=y

# This option outputs a banner to the console device during boot up.
### CONFIG_BOOT_BANNER=y

# Misc. settings
CONFIG_OBJECT_TRACING=y
CONFIG_THREAD_MONITOR=y
CONFIG_INIT_STACKS=y
CONFIG_THREAD_NAME=y
CONFIG_SHELL_VT100_COLORS=n

# CONFIG_SHELL_METAKEYS=y
CONFIG_SHELL_HELP=y

# ################################################################################
# # MCUboot (compile MCUboot-compliant) #
# #######################################
# # The settings below are copied from
# # zephyr/samples/subsys/usb/dfu/prj.conf
# # Settings which I have already set are commented out.

# # This sets the compilation process to "MCUboot" mode and
# # compiles the .hex file according to the partitions.
# CONFIG_BOOTLOADER_MCUBOOT=y

# # The settings below are for DFU (direct firmware update).
# # Because these settings are rather "messy" the "SMP Server Sample"
# # might have an alternative to DFU - namely SMP (over Shell or CDC).
# CONFIG_STDOUT_CONSOLE=y
# #CONFIG_GPIO=y
# #CONFIG_USB=y
# #CONFIG_USB_DEVICE_STACK=y
# #CONFIG_USB_DEVICE_PRODUCT="Zephyr DFU sample"
# CONFIG_USB_DFU_CLASS=y
# CONFIG_FLASH=y
# CONFIG_IMG_MANAGER=y
# CONFIG_FLASH_PAGE_LAYOUT=y
# CONFIG_LOG=y
# CONFIG_USB_DRIVER_LOG_LEVEL_ERR=y
# CONFIG_USB_DEVICE_LOG_LEVEL_ERR=y

# ################################################################################

#CONFIG_SHELL_LOG_BACKEND=y

#CONFIG_UART_CONSOLE=y
#CONFIG_STDOUT_CONSOLE=y
```

## src/main.c
```c
/*
 * Copyright (c) 2016 Intel Corporation.
 *
 * SPDX-License-Identifier: Apache-2.0
 */

#include <zephyr.h>
#include <stdio.h>
#include <sys/printk.h>
#include <sys/util.h>
#include <string.h>
#include <usb/usb_device.h>
#include <drivers/uart.h>

#include <device.h>
#include <devicetree.h>
#include <drivers/gpio.h>

#include <drivers/sensor.h>
#include <drivers/sensor/lsm9ds1.h>

#include "state/state.h"
#include "shell/shell.h"
#include "usb/usb.h"


/* The devicetree node identifier for the "led0" alias. */
#define LED0_NODE DT_ALIAS(led0)

#if DT_NODE_HAS_STATUS(LED0_NODE, okay)
#define LED0	DT_GPIO_LABEL(LED0_NODE, gpios)
#define PIN	DT_GPIO_PIN(LED0_NODE, gpios)
#define FLAGS	DT_GPIO_FLAGS(LED0_NODE, gpios)
#else
/* A build error here means your board isn't set up to blink an LED. */
#error "Unsupported board: led0 devicetree alias is not defined"
#define LED0	""
#define PIN	0
#define FLAGS	0
#endif

void main(void)
{
	init_usb(false);

	bool led_is_on = true;
	int ret;

	const struct device *dev = device_get_binding(LED0);
	if (dev == NULL) {
		return;
	}

	ret = gpio_pin_configure(dev, PIN, GPIO_OUTPUT_ACTIVE | FLAGS);
	if (ret < 0) {
		return;
	}

	////////////////////
	// const struct device *lsm9ds1_dev = device_get_binding(
    //     DT_LABEL(DT_INST(0, st_lsm9ds1)) //"LSM9DS1"
    // );

    // if (lsm9ds1_dev == NULL) {
    //     printk("[ERROR] LSM9DS1 was not found.\n");
    // } else {
    //     printk("Alles top.\n");
    // }
    // printk("Calibration started ...\n");
    // sensor_sample_fetch_chan(lsm9ds1_dev, SENSOR_CHAN_CALIBRATE_GYRO);
    // printk("Calibrated\n");
	//////////////////////

	while (1) {
		gpio_pin_set(dev, PIN, (int)led_is_on);
		led_is_on = !led_is_on;

		// struct sensor_value data[3];
        // sensor_sample_fetch(lsm9ds1_dev);
        // sensor_channel_get(lsm9ds1_dev, SENSOR_CHAN_GYRO_XYZ, data);
		// printf("%f | %f | %f\n",
        //     sensor_value_to_double(data),
        //     sensor_value_to_double(data+1),
        //     sensor_value_to_double(data+2)
        // );

		if (get_led_is_fast()) {
			k_msleep(100);
		} else {
			k_msleep(1000);
		}
	}
}
```
