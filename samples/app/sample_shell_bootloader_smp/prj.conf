## CMakeLists.txt
```
# SPDX-License-Identifier: Apache-2.0

cmake_minimum_required(VERSION 3.13.1)

set(BOARD arduino_nano_33_ble_sense)

find_package(Zephyr REQUIRED HINTS $ENV{ZEPHYR_BASE})

project(my-shell)

FILE(GLOB_RECURSE app_sources src/*.c)
target_sources(app PRIVATE ${app_sources})
```

## prj.conf
```kconfig
################################################################################
# GENERAL #
###########

# This option directs printk() debugging output to the supported console device,
# rather than suppressing the generation of printk() output entirely.
# Output is sent immediately, without any mutual exclusion or buffering.
CONFIG_PRINTK=y

# Global switch for the logger,
# when turned off log calls will not be compiled in.
### CONFIG_LOG=y

################################################################################
# DRIVERS #
###########

# Include GPIO drivers in system config
CONFIG_GPIO=y

# Enable USB drivers
CONFIG_USB=y

# Enable options for serial drivers.
CONFIG_SERIAL=y

# Enable console
CONFIG_CONSOLE=y

################################################################################
# USB #
#######

# Enable USB device stack
CONFIG_USB_DEVICE_STACK=y
# USB device product string.
CONFIG_USB_DEVICE_PRODUCT="Zephyr USB console sample"

# Enable this option to use the USB UART for console output. The output can
# be viewed from the USB host via /dev/ttyACM* port. Note that console inputs
# from the USB UART are not functional yet. Also since the USB layer currently
# doesn't support multiple interfaces, this shouldn't be selected in
# conjunction with, say, USB Mass Storage.
CONFIG_USB_UART_CONSOLE=y

################################################################################
# UART #
########

# USB CDC ACM device class driver. Default device name is “CDC_ACM_0”.
CONFIG_USB_CDC_ACM=y

# This option specifies the name of UART device to be used for the
# SHELL UART backend. In case when DTS is enabled (HAS_DTS),
# the default value is set from DTS chosen node ‘zephyr,shell-uart’
# but can be overridden here.
CONFIG_UART_SHELL_ON_DEV_NAME="CDC_ACM_0"

# This option specifies the name of UART device to be used for UART console.
CONFIG_UART_CONSOLE_ON_DEV_NAME="CDC_ACM_0"

# This option enables interrupt support for UART
# allowing console input and other UART based drivers.
CONFIG_UART_INTERRUPT_DRIVEN=y

# This enables the API for apps to control the serial line,
# such as baud rate, CTS and RTS.
# Implementation is up to individual driver. Says no if not sure.
CONFIG_UART_LINE_CTRL=y

################################################################################
# SHELL #
#########
# The settings below are partly from
# zephyr/samples/subsys/shell/shell_module/prj_minimal.conf

# Shell configurations
CONFIG_SHELL=y
CONFIG_SHELL_BACKEND_SERIAL=y
CONFIG_SHELL_STACK_SIZE=1024
CONFIG_SHELL_CMD_BUFF_SIZE=128

# Enable built-in commands like ‘clear’, ‘history’, etc.
CONFIG_SHELL_CMDS=y

# Enable commands history. History can be accessed using up and down arrows.
CONFIG_SHELL_HISTORY=y

# Enable printing help on wrong argument count.
CONFIG_SHELL_HELP_ON_WRONG_ARGUMENT_COUNT=y

# Enables using wildcards: * and ? in the shell.
CONFIG_SHELL_WILDCARD=n

# This shell provides access to basic kernel data like
# version, uptime and other useful information.
### CONFIG_KERNEL_SHELL=y

# Enable shell statistics.
### CONFIG_SHELL_STATS=y

# This option outputs a banner to the console device during boot up.
### CONFIG_BOOT_BANNER=y

# Misc. settings
CONFIG_OBJECT_TRACING=y
CONFIG_THREAD_MONITOR=y
CONFIG_INIT_STACKS=y
CONFIG_THREAD_NAME=y
CONFIG_SHELL_VT100_COLORS=n

################################################################################
# MCUboot (compile MCUboot-compliant) #
#######################################
# # The settings below are copied from
# # zephyr/samples/subsys/usb/dfu/prj.conf
# # Settings which I have already set are commented out.

# # This sets the compilation process to "MCUboot" mode and
# # compiles the .hex file according to the partitions.
# CONFIG_BOOTLOADER_MCUBOOT=y

# # The settings below are for DFU (direct firmware update).
# # Because these settings are rather "messy" the "SMP Server Sample"
# # might have an alternative to DFU - namely SMP (over Shell or CDC).
# CONFIG_STDOUT_CONSOLE=y
# #CONFIG_GPIO=y
# #CONFIG_USB=y
# #CONFIG_USB_DEVICE_STACK=y
# #CONFIG_USB_DEVICE_PRODUCT="Zephyr DFU sample"
# CONFIG_USB_DFU_CLASS=y
# CONFIG_FLASH=y
# CONFIG_IMG_MANAGER=y
# CONFIG_FLASH_PAGE_LAYOUT=y
# CONFIG_LOG=y
# CONFIG_USB_DRIVER_LOG_LEVEL_ERR=y
# CONFIG_USB_DEVICE_LOG_LEVEL_ERR=y

################################################################################
# SMP #
#######
# Enable mcumgr.
CONFIG_MCUMGR=y

# Some command handlers require a large stack.
CONFIG_SYSTEM_WORKQUEUE_STACK_SIZE=2048

# Ensure an MCUboot-compatible binary is generated.
CONFIG_BOOTLOADER_MCUBOOT=y

# Enable flash operations.
CONFIG_FLASH=y

# Required by the `taskstat` command.
CONFIG_THREAD_MONITOR=y

# Enable statistics and statistic names.
CONFIG_STATS=y
CONFIG_STATS_NAMES=y

# Enable most core commands.
CONFIG_MCUMGR_CMD_IMG_MGMT=y
CONFIG_MCUMGR_CMD_OS_MGMT=y
CONFIG_MCUMGR_CMD_STAT_MGMT=y

# Enable logging
CONFIG_LOG=y

# Enable the shell mcumgr transport.
CONFIG_MCUMGR_SMP_SHELL=y
```

## src/main.c
```c
/*
 * Copyright (c) 2016 Intel Corporation.
 *
 * SPDX-License-Identifier: Apache-2.0
 */

#include <zephyr.h>
#include <stdio.h>
#include <sys/printk.h>
#include <sys/util.h>
#include <string.h>
#include <usb/usb_device.h>
#include <drivers/uart.h>

#include <device.h>
#include <devicetree.h>
#include <drivers/gpio.h>

#include "state/state.h"
#include "shell/shell.h"
#include "usb/usb.h"

////////////////////////////////////////////////////////////////////////////////
// SMP Server
#include <stats/stats.h>

#ifdef CONFIG_MCUMGR_CMD_FS_MGMT
#include <device.h>
#include <fs/fs.h>
#include "fs_mgmt/fs_mgmt.h"
#include <fs/littlefs.h>
#endif
#ifdef CONFIG_MCUMGR_CMD_OS_MGMT
#include "os_mgmt/os_mgmt.h"
#endif
#ifdef CONFIG_MCUMGR_CMD_IMG_MGMT
#include "img_mgmt/img_mgmt.h"
#endif
#ifdef CONFIG_MCUMGR_CMD_STAT_MGMT
#include "stat_mgmt/stat_mgmt.h"
#endif

#define LOG_LEVEL LOG_LEVEL_DBG
#include <logging/log.h>
LOG_MODULE_REGISTER(smp_sample);

//#include "common.h"

/* Define an example stats group; approximates seconds since boot. */
STATS_SECT_START(smp_svr_stats)
STATS_SECT_ENTRY(ticks)
STATS_SECT_END;

/* Assign a name to the `ticks` stat. */
STATS_NAME_START(smp_svr_stats)
STATS_NAME(smp_svr_stats, ticks)
STATS_NAME_END(smp_svr_stats);

/* Define an instance of the stats group. */
STATS_SECT_DECL(smp_svr_stats) smp_svr_stats;

#ifdef CONFIG_MCUMGR_CMD_FS_MGMT
FS_LITTLEFS_DECLARE_DEFAULT_CONFIG(cstorage);
static struct fs_mount_t littlefs_mnt = {
	.type = FS_LITTLEFS,
	.fs_data = &cstorage,
	.storage_dev = (void *)FLASH_AREA_ID(storage),
	.mnt_point = "/lfs"
};
#endif
////////////////////////////////////////////////////////////////////////////////


/* The devicetree node identifier for the "led0" alias. */
#define LED0_NODE DT_ALIAS(led0)

#if DT_NODE_HAS_STATUS(LED0_NODE, okay)
#define LED0	DT_GPIO_LABEL(LED0_NODE, gpios)
#define PIN	DT_GPIO_PIN(LED0_NODE, gpios)
#define FLAGS	DT_GPIO_FLAGS(LED0_NODE, gpios)
#else
/* A build error here means your board isn't set up to blink an LED. */
#error "Unsupported board: led0 devicetree alias is not defined"
#define LED0	""
#define PIN	0
#define FLAGS	0
#endif

void main(void)
{
	int rc = STATS_INIT_AND_REG(smp_svr_stats, STATS_SIZE_32,
				"smp_svr_stats");

	if (rc < 0) {
		LOG_ERR("Error initializing stats system [%d]", rc);
	}

	/* Register the built-in mcumgr command handlers. */
	#ifdef CONFIG_MCUMGR_CMD_FS_MGMT
		rc = fs_mount(&littlefs_mnt);
		if (rc < 0) {
			LOG_ERR("Error mounting littlefs [%d]", rc);
		}

		fs_mgmt_register_group();
	#endif
	#ifdef CONFIG_MCUMGR_CMD_OS_MGMT
		os_mgmt_register_group();
	#endif
	#ifdef CONFIG_MCUMGR_CMD_IMG_MGMT
		img_mgmt_register_group();
	#endif
	#ifdef CONFIG_MCUMGR_CMD_STAT_MGMT
		stat_mgmt_register_group();
	#endif
	#ifdef CONFIG_MCUMGR_SMP_BT
		start_smp_bluetooth();
	#endif
	#ifdef CONFIG_MCUMGR_SMP_UDP
		start_smp_udp();
	#endif

	if (IS_ENABLED(CONFIG_USB)) {
		rc = usb_enable(NULL);
		if (rc) {
			LOG_ERR("Failed to enable USB");
			return;
		}
	}

	////////////////////////////////////////////////////////////////////////////
	//init_usb(false);

	bool led_is_on = true;
	int ret;

	const struct device *dev = device_get_binding(LED0);
	if (dev == NULL) {
		return;
	}

	ret = gpio_pin_configure(dev, PIN, GPIO_OUTPUT_ACTIVE | FLAGS);
	if (ret < 0) {
		return;
	}

	while (1) {
		gpio_pin_set(dev, PIN, (int)led_is_on);
		led_is_on = !led_is_on;

		if (get_led_is_fast()) {
			k_msleep(100);
		} else {
			k_msleep(1000);
		}
	}
}
```
