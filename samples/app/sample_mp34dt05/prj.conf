## CMakeLists.txt
```
cmake_minimum_required(VERSION 3.13.1)

# Re-direct the directory where the 'boards' directory is found from
# $ZEPHYR_BASE to this directory.
#set(BOARD_ROOT ${CMAKE_CURRENT_LIST_DIR})
set(BOARD arduino_nano_33_ble_sense)

# Add out of tree drivers
# list(APPEND ZEPHYR_EXTRA_MODULES
#   ${CMAKE_CURRENT_SOURCE_DIR}/drivers/sensor/lsm9ds1
# )

# list(APPEND ZEPHYR_EXTRA_MODULES
#   ${CMAKE_CURRENT_SOURCE_DIR}/drivers/sensor/mp34dt05
# )

# list(APPEND ZEPHYR_EXTRA_MODULES
#   ${CMAKE_CURRENT_SOURCE_DIR}/drivers/audio/pdm
# )


# This sample is only compatible with arduino_nano_33_ble_sense because
# it has re-directed the 'boards' directory to a directory that only
# contains this board.
# set(BOARD arduino_nano_33_ble_sense)

# Find Zephyr. This also loads Zephyr's build system.
find_package(Zephyr REQUIRED HINTS $ENV{ZEPHYR_BASE}) #find_package(Zephyr)
project(sensor_test)

# Add your source file to the "app" target. This must come after
# find_package(Zephyr) which defines the target.
#target_sources(app PRIVATE src/main.c src/MadgwickAHRS.c)
FILE(GLOB_RECURSE app_sources src/*.c)
target_sources(app PRIVATE ${app_sources})
```

## prj.conf
```kconfig
################################################################################
### ...

# For using <math.h>
CONFIG_NEWLIB_LIBC=y

# For using printf with floats
CONFIG_NEWLIB_LIBC_FLOAT_PRINTF=y

################################################################################
### General drivers

# Enable SPI driver. Cannot be used together with led_builtin.
#CONFIG_SPI=y

# Enable UART driver
CONFIG_SERIAL=y

# Enable I2C driver
CONFIG_I2C=y

################################################################################
### Sensor drivers

# Enable "sensor" => Required for using the sensor drivers
CONFIG_SENSOR=y

# Enable APDS 9960 driver (proximity, light, color, gesture)
CONFIG_APDS9960=y

# Enable HTS221 driver (temperature, humidity)
CONFIG_HTS221=y
CONFIG_HTS221_TRIGGER_NONE=y

# Enable LPS22HB driver (pressure, temperature)
CONFIG_LPS22HB=y

# Enable LSM9DS1 driver (acceleration, gyroskop, magnetic)
CONFIG_LSM9DS1=y
CONFIG_LSM9DS1_GYRO_LOW_POWER=y

# Enable MP34DT05 driver (microphone)
CONFIG_AUDIO=y
CONFIG_PDM=y
#CONFIG_MP34DT05=y
#CONFIG_ADC=y
#CONFIG_NRFX_PDM=y

CONFIG_I2C_NRFX=y
# CONFIG_I2C_1_NRF_TWIM=y
#CONFIG_I2C_INIT_PRIORITY=60
#CONFIG_I2C_0=n
#CONFIG_LSM9DS1_I2C_MASTER_DEV_NAME="I2C_1"

################################################################################
# Enable USB (NRFX driver + device stack)
CONFIG_USB=y

# Enable USB console output (input not yet supported)
CONFIG_CONSOLE=y
CONFIG_USB_UART_CONSOLE=y
#CONFIG_USB_UART_DTR_WAIT=y
CONFIG_UART_LINE_CTRL=y
CONFIG_UART_INTERRUPT_DRIVEN=y
CONFIG_UART_CONSOLE_ON_DEV_NAME="CDC_ACM_0"

# Enable printk(...) output via console
CONFIG_PRINTK=y
CONFIG_UART_CONSOLE_INIT_PRIORITY=91

CONFIG_LOG=y
CONFIG_LOG_PRINTK=y
################################################################################
```

## src/main.c
```c
/*
* Copyright (c) 2016 Intel Corporation
*
* SPDX-License-Identifier: Apache-2.0
*/

#include <zephyr.h>
#include <device.h>
#include <devicetree.h>
#include <drivers/gpio.h>
#include <drivers/sensor.h>
#include <sys/printk.h>
#include <stdio.h>
#include <string.h>
//#include <nrfx/drivers/include/nrfx_pdm.h>
//#include <nrfx_pdm.h>
//#include <audio/dmic.h>

// #include "lsm9ds1.h"
// #include "MadgwickAHRS.h"

#include "usb/usb.h"
//#include "pdm.h"

#define MIC_PWR_ON 1
#define MAX_ITERATIONS 1
#define MAX_SAMPLES 50

#define PDM_NODE   DT_NODELABEL(pdm)
#define PDM_LABEL  DT_LABEL(PDM_NODE)

////////////////////////////////////////////////////////////////////////////////
////////////////////////////////////////////////////////////////////////////////
////////////////////////////////////////////////////////////////////////////////

static struct device *pdm_dev;
static uint16_t samples = 0, iterations;

int16_t avg = 0;

// static void pdm_data_handler(int16_t *data, uint16_t data_size)
// {
// 	samples++;

// 	if (samples == MAX_SAMPLES) {
// 		samples = 0;
// 		iterations++;
// 		printk("[ITERATION %u/%d] Received %d samples of size %u\n",
// 			iterations, MAX_ITERATIONS, MAX_SAMPLES, data_size);
// 		int result = pdm_stop(pdm_dev);

// 		if (result != 0) {
// 			printk("Failed to start PDM sampling, error %d\n",
// 				result);
// 			return;
// 		}
// 		if (iterations != MAX_ITERATIONS) {
// 			result = pdm_start(pdm_dev);
// 			if (result != 0) {
// 				printk("Failed to start PDM sampling, error %d\n",
// 					result);
// 				return;
// 			}
// 		} else {
// 			printk("Program finished.\n");
// 		}
// 	}
// }

// #define PDM_BUF_ADDRESS 0x20000000 // buffer address in RAM
// #define PDM_BUF_SIZE 256 //size in 32 bit words --> 40 bytes

// int16_t pdm_buf[PDM_BUF_SIZE];

// void nrfx_pdm_event_handler(nrfx_pdm_evt_t const *const p_evt)
// {
//     printk("PDM Handler called gets executed.\n");

//     if (p_evt->buffer_requested) {
//         nrfx_pdm_buffer_set(pdm_buf, PDM_BUF_SIZE);
//     }
//     if (p_evt->buffer_released != 0) {
//         printk("Out: %.2x %2x\r\n", (uint16_t)pdm_buf[0],
//                 (uint16_t)pdm_buf[1]);
//     }
// }

// #define NRF_GPIO_PIN_MAP(port, pin) (((port) << 5) | ((pin) & 0x1F))
// static void pdm_init(void)
// {
//     printk("NRFX_PDM_ENABLED: %d\n", NRFX_PDM_ENABLED);
//     printk("CLK Pin: %d\n", NRF_GPIO_PIN_MAP(0, 26));
//     printk("DIN Pin: %d\n", NRF_GPIO_PIN_MAP(0, 25));
//     nrfx_pdm_config_t pdm_config = NRFX_PDM_DEFAULT_CONFIG(
//         NRF_GPIO_PIN_MAP(0, 26),
//         NRF_GPIO_PIN_MAP(0, 25)
//     );

//     nrfx_pdm_init(&pdm_config, nrfx_pdm_event_handler);
//     //irq_enable(29);
//     nrfx_pdm_buffer_set(pdm_buf, PDM_BUF_SIZE);
// }

////////////////////////////////////////////////////////////////////////////////
////////////////////////////////////////////////////////////////////////////////
////////////////////////////////////////////////////////////////////////////////

void main(void)
{
    init_usb(true);

    int ret = 0;

    ////////////////////////////////////////////////////////////////////////////
    // Turn on led_pwr
    struct device *led_pwr_dev = device_get_binding(
        DT_GPIO_LABEL(DT_NODELABEL(led_pwr), gpios)
    );
    if (led_pwr_dev == NULL) {
        return;
    }
    ret = gpio_pin_configure(
        led_pwr_dev,
        DT_GPIO_PIN(DT_NODELABEL(led_pwr), gpios), GPIO_OUTPUT_HIGH
    );
    if (ret < 0) {
        return;
    }

    ////////////////////////////////////////////////////////////////////////////
    // Turn off led_builtin
    struct device *led_builtin_dev = device_get_binding(
        DT_GPIO_LABEL(DT_NODELABEL(led_builtin), gpios)
    );
    if (led_builtin_dev == NULL) {
        return;
    }
    ret = gpio_pin_configure(
        led_builtin_dev,
        DT_GPIO_PIN(DT_NODELABEL(led_builtin), gpios), GPIO_OUTPUT_LOW
    );
    if (ret < 0) {
        return;
    }

    ////////////////////////////////////////////////////////////////////////////
    // Get ... device
    // struct device *mp34dt05_dev = device_get_binding(
    //     DT_LABEL(DT_INST(0, st_mp34dt05))
    // );

    // if (mp34dt05_dev == NULL) {
    //     printk("Mikrofon nicht gefunden. Programmabbruch...\n");
    // } else {
    //     printk("Mikrofon gefunden!\n");
    // }

    // pdm_init();
    // printk("[after init] nrfx_pdm_enable_check() => %d\n", nrfx_pdm_enable_check());

    int result;

	samples = 0;
	iterations = 0;

	pdm_dev = device_get_binding(PDM_LABEL);
	if (!pdm_dev) {
		printk("Cannot find %s!\n", PDM_LABEL);
		return -ENOENT;
	}
	printk("Successfully bound PDM driver.\n");

    dmic_trigger(pdm_dev, DMIC_TRIGGER_START);

    k_msleep(2000);

    dmic_trigger(pdm_dev, DMIC_TRIGGER_STOP);

    // result = pdm_set_data_handler(pdm_dev, pdm_data_handler);
	// if (result != 0) {
	// 	printk("Failed to set the data handler, error %d\n", result);
	// 	return result;
	// }

	// result = pdm_start(pdm_dev);
	// if (result != 0) {
	// 	printk("Failed to start PDM sampling, error %d\n", result);
	// 	return result;
	// }

    k_msleep(300);

    ////////////////////////////////////////////////////////////////////////////
    bool led_is_on = true;

    while (1) {
        gpio_pin_set(
            led_builtin_dev,
            DT_GPIO_PIN(DT_NODELABEL(led_builtin), gpios),
            (int)led_is_on
        );

        led_is_on = !led_is_on;
        k_msleep(1000);

        // Sensor values - START
        // nrfx_pdm_start();
        // printk("[loop] nrfx_pdm_enable_check() => %d\n", nrfx_pdm_enable_check());

        // k_msleep(2000);

        // nrfx_pdm_stop();

        // Sensor values - END
    }
    ////////////////////////////////////////////////////////////////////////////
}
```
