## boards/arm/arduino_nano_33_ble_sense/Kconfig
```kconfig
# Arduino Nano 33 BLE Sense board configuration

# Copyright (c) 2016 Nordic Semiconductor ASA
# Copyright (c) 2020 Christopher Funk
# SPDX-License-Identifier: Apache-2.0

config BOARD_ENABLE_DCDC
	bool "Enable DCDC mode"
	select SOC_DCDC_NRF52X
	default y
	depends on BOARD_ARDUINO_NANO_33_BLE_SENSE

config SENSOR_POWER_PINS_INIT_PRIORITY
	int "Init priority for sensor power pins"
	default 89
	depends on BOARD_ARDUINO_NANO_33_BLE_SENSE
```

## boards/arm/arduino_nano_33_ble_sense/Kconfig.board
```kconfig
# Arduino Nano 33 BLE Sense board configuration

# Copyright (c) 2016 Nordic Semiconductor ASA
# Copyright (c) 2020 Christopher Funk
# SPDX-License-Identifier: Apache-2.0

config BOARD_ARDUINO_NANO_33_BLE_SENSE
	bool "Arduino Nano 33 BLE Sense"
	depends on SOC_NRF52840_QIAA
```

## boards/arm/arduino_nano_33_ble_sense/Kconfig.defconfig
```kconfig
# Arduino Nano 33 BLE Sense board configuration

# Copyright (c) 2016 Nordic Semiconductor ASA
# Copyright (c) 2020 Christopher Funk
# SPDX-License-Identifier: Apache-2.0

if BOARD_ARDUINO_NANO_33_BLE_SENSE

config BOARD
	default "arduino_nano_33_ble_sense"

if USB

config USB_NRFX
	default y

config USB_DEVICE_STACK
	default y

endif # USB

config IEEE802154_NRF5
	default y
	depends on IEEE802154

config BT_CTLR
	default BT

endif # BOARD_ARDUINO_NANO_33_BLE
```

## boards/arm/arduino_nano_33_ble_sense/arduino_nano_33_ble_sense_defconfig
```kconfig
# SPDX-License-Identifier: Apache-2.0

# Set SoC type and board
CONFIG_SOC_SERIES_NRF52X=y
CONFIG_SOC_NRF52840_QIAA=y
CONFIG_BOARD_ARDUINO_NANO_33_BLE_SENSE=y

# Enable MPU
CONFIG_ARM_MPU=y

# Enable RTT
CONFIG_USE_SEGGER_RTT=y

# Enable FPU for all threads
CONFIG_FPU=y
CONFIG_FPU_SHARING=y

# Enable GPIO driver
CONFIG_GPIO=y

# Enable reset pin
CONFIG_GPIO_AS_PINRESET=y
```

## boards/arm/arduino_nano_33_ble_sense/dts/bindings/gpio/arduino,nano-33-header.yml
```yaml
# Copyright (c) 2019 Foundries.io
# Copyright (C) 2019 Peter Bigot Consulting, LLC
# Copyright (c) 2020 Christopher Funk
# SPDX-License-Identifier: Apache-2.0

description: |
    GPIO pins exposed on the Arduino Nano 33 BLE Sense's headers.

    This binding provides a nexus mapping for 22 pins, as depicted below:

    0 - D13    | D12/MISO - 21
    x - +3V3   | D11/MOSI - 20
    x - AREF   |      D10 - 19
    1 - A0     |       D9 - 18
    2 - A1     |       D8 - 17
    3 - A2     |       D7 - 16
    4 - A3     |       D6 - 15 
    5 - A4/SDA |       D5 - 14
    6 - A5/SCL |       D4 - 13
    7 - A6     |       D3 - 12
    8 - A7     |       D2 - 11
    x - +5V    |      GND - x
    x - ~RESET |   ~RESET - x
    x - GND    |    D1/TX - 10
    x - VIN    |    D0/RX - 9

compatible: "arduino,nano-33-header"

include: [gpio-nexus.yaml, base.yaml]
```

## boards/arm/arduino_nano_33_ble_sense/dts/bindings/iio/adc/arduino,nano-33-adc.yaml
```yaml
# Copyright (C) 2019 Peter Bigot Consulting, LLC
# Copyright (C) 2020 Christopher Funk
# SPDX-License-Identifier: Apache-2.0

description: |
    ADC channels exposed on the Arduino Nano 33 BLE Sense's headers.

    This binding provides a nexus mapping for 8 pins, where the mapping corresponds to the Nano 33 header and the NRF52840 pins as follows:

    0 - A0 - AIN2
    1 - A1 - AIN3
    2 - A2 - AIN6
    3 - A3 - AIN5
    4 - A4 - AIN7
    5 - A5 - AIN0
    6 - A6 - AIN4
    7 - A7 - AIN1

compatible: "arduino,nano-33-adc"

include: base.yaml

properties:
    io-channel-map:
      type: compound
      required: true

    io-channel-map-mask:
      type: compound
      required: false

    io-channel-map-pass-thru:
      type: compound
      required: false

    "#io-channel-cells":
      type: int
      required: true
      description: Number of items to expect in an ADC specifier
```

## drivers/audio/pdm/Kconfig
```kconfig
menuconfig PDM
	bool "PDM (Pulse Density Modulation) Drivers"
	help
	  Enable config options for PDM drivers.

if PDM

module = PDM
module-str = pdm
source "subsys/logging/Kconfig.template.log_config"

# Workaround for not being able to have commas in macro arguments
DT_COMPAT_NORDIC_NRF_PDM   := nordic,nrf-pdm

config PDM_NRFX
	bool "nRF PDM nrfx driver"
	default y
	depends on HAS_HW_NRF_PDM && $(dt_nodelabel_has_compat,pdm,$(DT_COMPAT_NORDIC_NRF_PDM))
	select NRFX_PDM
	help
		Enable support for nrfx Hardware PDM driver for nRF52 MCU series.

endif # PDM
```
